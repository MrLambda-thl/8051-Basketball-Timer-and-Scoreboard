// ============================================================================
// 文件：src/oled.c
// 用途：OLED 软件 I2C 与静态图片显示。
//
// 用 P1.7 作为 SCL、P1.6 作为 SDA，通过软件改变引脚电平模拟 I2C 通信。
// 实现起始/停止、发送字节、上电初始化以及逐页写入 128×64 单色图片。
// 主循环启动阶段调用 oled_init() 和 oled_show_image()，之后屏幕自行保持画面。
// 图片来自 oled_image.h，包含图标、姓名、学号和 GUET；当前初始化保留 180 度旋转。
// board.h 中 OLED_TEST_ENABLED 为 0 时，本文件里的 OLED 功能不参与编译。
// ============================================================================

#include "oled.h"

#if OLED_TEST_ENABLED
#include "oled_image.h"                                                         // 128×64 单色图片，数据存在程序闪存中
/* OLED 模块：P1.7=SCL、P1.6=SDA，默认 I2C 地址为 0x3C。
 * 本次按用户确认的新版本 5 V 兼容模块直接连接；旧版手册对应的 3.3 V
 * 模块仍须经过电平转换。位地址 0x96、0x97 对应 P1.6、P1.7。 */
__sbit __at (0x97) OLED_SCL;                                                    // SDCC 的位变量写法：给 P1.7 起名 OLED_SCL，赋值就能操作时钟线。
__sbit __at (0x96) OLED_SDA;                                                    // 给 P1.6 起名 OLED_SDA，用来发送和读取数据位。


// 函数用途：oled_i2c_delay() —— 为软件 I2C 提供短暂的电平保持时间。
// 工作说明：通过短循环延时，让数据和时钟电平保持一小段时间；它不是精确的毫秒或微秒计时器。
static void oled_i2c_delay(void)                                                // 通过短循环给软件 I2C 留出电平保持时间。
{                                                                               // 开始这一段语句块；配对的右花括号表示这段结束。
    volatile unsigned char i;                                                   // 延时用的计数变量；volatile 要求编译器保留对它的读写。
    for (i = 0; i < 6; ++i) { }                                                 // 空循环六次，给 I2C 信号留出短暂稳定时间；不是精确的微秒延时。
}                                                                               // 结束这一层语句块，按外层循环、判断或函数的结构继续执行。

// 函数用途：oled_i2c_start() —— 产生 I2C 起始条件。
// 工作说明：先释放数据线和时钟线，再在 SCL 为高时把 SDA 拉低，表示本次传输开始。
static void oled_i2c_start(void)                                                // 在时钟为高时把数据从高拉低，产生 I2C 起始条件。
{                                                                               // 开始这一段语句块；配对的右花括号表示这段结束。
    OLED_SDA = 1;                                                               // 数据线写 1，释放 SDA，使它可以被上拉为高电平或被 OLED 拉低应答。
    OLED_SCL = 1;                                                               // 释放时钟线到高电平；发送时 OLED 在相应时钟阶段读取数据。
    oled_i2c_delay();                                                           // 调用短延时函数，让当前时钟或数据电平保持一小段时间。
    OLED_SDA = 0;                                                               // 将 SDA 主动拉低，产生起始/停止条件的一部分或输出数据 0。
    oled_i2c_delay();                                                           // 调用短延时函数，让当前时钟或数据电平保持一小段时间。
    OLED_SCL = 0;                                                               // 将时钟线拉低，结束高电平阶段，为下一次改变数据做准备。
}                                                                               // 结束这一层语句块，按外层循环、判断或函数的结构继续执行。

// 函数用途：oled_i2c_stop() —— 产生 I2C 停止条件。
// 工作说明：在 SCL 为高时把 SDA 从低释放为高，表示本次传输结束。
static void oled_i2c_stop(void)                                                 // 在时钟为高时把数据从低释放为高，产生 I2C 停止条件。
{                                                                               // 开始这一段语句块；配对的右花括号表示这段结束。
    OLED_SDA = 0;                                                               // 将 SDA 主动拉低，产生起始/停止条件的一部分或输出数据 0。
    OLED_SCL = 1;                                                               // 释放时钟线到高电平；发送时 OLED 在相应时钟阶段读取数据。
    oled_i2c_delay();                                                           // 调用短延时函数，让当前时钟或数据电平保持一小段时间。
    OLED_SDA = 1;                                                               // 数据线写 1，释放 SDA，使它可以被上拉为高电平或被 OLED 拉低应答。
    oled_i2c_delay();                                                           // 调用短延时函数，让当前时钟或数据电平保持一小段时间。
}                                                                               // 结束这一层语句块，按外层循环、判断或函数的结构继续执行。

// 函数用途：oled_i2c_write() —— 向 OLED 发送一个字节，并读取应答。
// 工作说明：参数 value 是待发字节；从最高位开始发送八位，再读第九个时钟的应答，返回 1 表示应答、0 表示未应答。
static unsigned char oled_i2c_write(unsigned char value)                        // 发送参数 value 的八个数据位，返回是否收到应答。
{                                                                               // 开始这一段语句块；配对的右花括号表示这段结束。
    unsigned char i, acknowledged;                                              // i 统计发送的 8 个数据位，acknowledged 保存 OLED 是否应答。
    for (i = 0; i < 8; ++i) {                                                   // 一个字节有 8 位，因此循环发送 8 次。
        OLED_SDA = (value & 0x80) != 0;                                         // 0x80 只取字节最高位；最高位是 1 就释放 SDA，否则拉低 SDA。
        oled_i2c_delay();                                                       // 调用短延时函数，让当前时钟或数据电平保持一小段时间。
        OLED_SCL = 1;                                                           // 释放时钟线到高电平；发送时 OLED 在相应时钟阶段读取数据。
        oled_i2c_delay();                                                       // 调用短延时函数，让当前时钟或数据电平保持一小段时间。
        OLED_SCL = 0;                                                           // 将时钟线拉低，结束高电平阶段，为下一次改变数据做准备。
        value <<= 1;                                                            // 字节左移一位，把下一位推到最高位位置；移出的位被丢弃。
    }                                                                           // 结束这一层语句块，按外层循环、判断或函数的结构继续执行。
    OLED_SDA = 1;                                                               // 数据线写 1，释放 SDA，使它可以被上拉为高电平或被 OLED 拉低应答。
    oled_i2c_delay();                                                           // 调用短延时函数，让当前时钟或数据电平保持一小段时间。
    OLED_SCL = 1;                                                               // 释放时钟线到高电平；发送时 OLED 在相应时钟阶段读取数据。
    oled_i2c_delay();                                                           // 调用短延时函数，让当前时钟或数据电平保持一小段时间。
    acknowledged = (OLED_SDA == 0);                                             // 第九个时钟读取应答：OLED 拉低 SDA 时比较成立，记录为 1。
    OLED_SCL = 0;                                                               // 将时钟线拉低，结束高电平阶段，为下一次改变数据做准备。
    return acknowledged;                                                        // 把应答结果交回调用者；当前上层调用没有检查该返回值。
}                                                                               // 结束这一层语句块，按外层循环、判断或函数的结构继续执行。

// 函数用途：oled_command() —— 向 OLED 发送一条命令字节。
// 工作说明：参数 command 是命令或其参数；按起始、设备地址、命令控制字节、具体内容、停止的顺序完成一次写入。
static void oled_command(unsigned char command)                                 // 向 OLED 发送参数 command 指定的一条命令。
{                                                                               // 开始这一段语句块；配对的右花括号表示这段结束。
    oled_i2c_start();                                                           // 发出 I2C 起始条件，告诉总线上的器件一次传输开始。
    oled_i2c_write(0x78);                                                       // 发送 OLED 的 7 位地址 0x3C 左移一位加写位 0，即 0x78。
    oled_i2c_write(0x00);                                                       // 控制字节 0x00 表示后续字节按命令解释。
    oled_i2c_write(command);                                                    // 将传入的 command 命令字节发送给 OLED。
    oled_i2c_stop();                                                            // 发出 I2C 停止条件，结束这一段传输。
}                                                                               // 结束这一层语句块，按外层循环、判断或函数的结构继续执行。

// 函数用途：oled_init() —— 设置 OLED 的上电工作参数。
// 工作说明：配置对比度、显示行数、扫描方向、页寻址和内部电荷泵；保留当前整体旋转 180 度的显示方向。
void oled_init(void)                                                            // 依次发送 OLED 上电配置命令。
{                                                                               // 开始这一段语句块；配对的右花括号表示这段结束。
    OLED_SCL = 1;                                                               // 释放时钟线到高电平；发送时 OLED 在相应时钟阶段读取数据。
    OLED_SDA = 1;                                                               // 数据线写 1，释放 SDA，使它可以被上拉为高电平或被 OLED 拉低应答。
    // 0xAE：先关闭显示，避免初始化和写图期间出现杂乱画面。
    oled_command(0xae);                                                         // 初始化时先关闭显示
    oled_command(0x00);                                                         // 设置列地址低四位为 0，配合下一条命令从第 0 列开始。
    oled_command(0x10);                                                         // 设置列地址高四位为 0，与上一条组成列地址 0。
    oled_command(0x40);                                                         // 0x40：将显示起始行设为 0。
    oled_command(0x81);                                                         // 0x81：声明下一字节将设置对比度。
    oled_command(0xcf);                                                         // 对比度参数 0xCF；这是上一条命令的参数，不是独立的对比度命令。
    /* 同时反转列与行的扫描方向，使 OLED 全部内容旋转 180°。
     * 原来是 0xa1（列反向）、0xc8（行反向）；改为 0xa0、0xc0。
     * 图片数据及右侧文字不必逐点重排，后续写入的内容也会一起旋转。 */
    oled_command(0xa0);                                                         // 0xA0：设置列映射方向，与行扫描方向一起实现当前 180 度显示。
    oled_command(0xc0);                                                         // 0xC0：设置行扫描方向，与列映射方向配合。
    oled_command(0xa6);                                                         // 0xA6：正常显示，位图数据 1 点亮、0 熄灭。
    oled_command(0xa8);                                                         // 0xA8：声明下一字节将设置多路复用行数。
    // 0x3F=63，按行数减 1 编码，对应 64 行。
    oled_command(0x3f);                                                         // 64 行
    oled_command(0xd3);                                                         // 0xD3：声明下一字节将设置显示垂直偏移。
    oled_command(0x00);                                                         // 偏移量设为 0，不额外向上或向下移动画面。
    oled_command(0xd5);                                                         // 0xD5：声明下一字节将设置显示时钟分频与振荡参数。
    oled_command(0x80);                                                         // 时钟参数为 0x80，沿用此屏已验证可工作的初始化值。
    oled_command(0xd9);                                                         // 0xD9：声明下一字节将设置预充电周期。
    oled_command(0xf1);                                                         // 预充电参数为 0xF1，沿用当前屏已验证的配置。
    oled_command(0xda);                                                         // 0xDA：声明下一字节将设置 COM 引脚硬件配置。
    oled_command(0x12);                                                         // COM 配置参数 0x12，用于当前 128×64 屏。
    oled_command(0xdb);                                                         // 0xDB：声明下一字节将设置 VCOMH 电平。
    oled_command(0x30);                                                         // VCOMH 参数 0x30，保持已验证的屏幕配置。
    oled_command(0x20);                                                         // 0x20：声明下一字节将选择显存寻址方式。
    oled_command(0x02);                                                         // 0x02：选择页寻址，后续按页号与列地址写图。
    oled_command(0x8d);                                                         // 0x8D：声明下一字节将设置内部电荷泵。
    // 0x14：开启电荷泵，为 OLED 显示提供内部升压。
    oled_command(0x14);                                                         // 打开 OLED 内部升压电路
}                                                                               // 结束这一层语句块，按外层循环、判断或函数的结构继续执行。

// 函数用途：oled_show_image() —— 将整幅 128×64 单色位图写入 OLED。
// 工作说明：逐页发送 oled_image 中的 1024 字节，包含图标及文字；八页写完后打开显示。
void oled_show_image(void)                                                      // 逐页写入整幅 128×64 单色位图。
{                                                                               // 开始这一段语句块；配对的右花括号表示这段结束。
    unsigned char page, column;                                                 // page 表示第几页，column 表示这一页第几列。
    for (page = 0; page < 8; ++page) {                                          // 屏幕高 64 像素，每页 8 像素，共逐页写入 8 页。
        oled_command(0xb0 | page);                                              // 将页号合并到 0xB0 命令中，选择第 0～7 页。
        oled_command(0x00);                                                     // 将当前页列地址的低四位设为 0，从该页第 0 列开始。
        oled_command(0x10);                                                     // 将列地址高四位设为 0，配合上一命令定位到第 0 列。
        oled_i2c_start();                                                       // 发出 I2C 起始条件，告诉总线上的器件一次传输开始。
        oled_i2c_write(0x78);                                                   // 发送 OLED 的 7 位地址 0x3C 左移一位加写位 0，即 0x78。
        // 控制字节 0x40 表示后续为像素数据，不是初始化命令。
        oled_i2c_write(0x40);                                                   // 后续字节是显示数据
        for (column = 0; column < 128; ++column)                                // 从列 0 写到列 127，一页共发送 128 个字节。
            oled_i2c_write(oled_image[(unsigned int)page * 128 + column]);      // 页号*128+列号算出图片数组下标；先转 16 位以容纳最大下标 1023。
        oled_i2c_stop();                                                        // 发出 I2C 停止条件，结束这一段传输。
    }                                                                           // 结束这一层语句块，按外层循环、判断或函数的结构继续执行。
    oled_command(0xaf);                                                         // 数据写完后点亮显示屏
}                                                                               // 结束这一层语句块，按外层循环、判断或函数的结构继续执行。

#endif                                                                          // OLED_TEST_ENABLED
