// ============================================================================
// 文件：src/countdown.c
// 用途：倒计时控制。
//
// 保存当前剩余秒数、设定秒数、运行状态，以及不足一秒的毫秒累计值。
// 提供加减一分钟、开始/暂停、恢复设定时间等操作；时间上限为 99 分 59 秒。
// scheduler.c 每 1 毫秒调用 tick_countdown()，累计满 1000 毫秒才减去一秒。
// 时间变化通过 display_dirty 通知显示模块；特定时间点通知蜂鸣器和串口模块。
// ============================================================================

#include "countdown.h"
#include "buzzer.h"
#include "serial.h"

volatile unsigned int remaining_seconds = 60;                                   // 保存剩余总秒数，初值 60 即 1 分钟；本工具链的 unsigned int 为 16 位。
static volatile unsigned int preset_seconds = 60;                               // 保存复位目标，初始为 60 秒；手动加减时间时会更新它。
static volatile unsigned int milliseconds = 0;                                  // 记录这一秒已过去的毫秒数；从 0 累加到 1000 后重新计数。
volatile unsigned char running = 0;                                             // 1：倒计时进行；0：暂停
volatile unsigned char display_dirty = 1;                                       // 计时数字需要重新拆成四位

// 函数用途：reset_timer() —— 复位倒计时并暂停。
// 工作说明：把剩余时间恢复到保存的设定值，清除毫秒累计和蜂鸣器提示进度，并通知主循环刷新显示。
void reset_timer(void)                                                          // 复位计时器：恢复设定时间并暂停。
{                                                                               // 开始这一段语句块；配对的右花括号表示这段结束。
    EA = 0;                                                                     // 暂停可屏蔽中断，让下面几步操作不会被定时器中途打断。
    running = 0;                                                                // 把运行标记清为 0，倒计时进入暂停状态。
    remaining_seconds = preset_seconds;                                         // 将保存的设定秒数复制给剩余秒数，例如设定 120 就回到 0200。
    milliseconds = 0;                                                           // 清除这一秒累计的毫秒数，从完整的一秒重新计算。
    alert30_ms = 0;                                                             // 清除 30 秒处的三声提示进度。
    beep_phase_ms = 0;                                                          // 把间歇鸣叫的周期位置归零，从周期起点开始。
    P1 &= (unsigned char)~ALERT_BIT;                                            // ~ 将 0x10 取反，再用 &= 只清除 P1.4，关闭蜂鸣器控制输出。
    display_dirty = 1;                                                          // 标记计时数字已改变，主循环稍后重新计算四个显示数字。
    EA = 1;                                                                     // 重新打开总中断；各中断还要由自己的允许位决定是否响应。
}                                                                               // 结束这一层语句块，按外层循环、判断或函数的结构继续执行。

// 函数用途：change_minute() —— 手动增加或减少一分钟。
// 工作说明：参数 increase 为 1 时加 60 秒，为 0 时减 60 秒；检查上下限，并把新时间保存为复位目标。
void change_minute(unsigned char increase)                                      // 调节时间：参数 increase 为 1 加一分钟，为 0 减一分钟。
{                                                                               // 开始这一段语句块；配对的右花括号表示这段结束。
    EA = 0;                                                                     // 暂停可屏蔽中断，让下面几步操作不会被定时器中途打断。
    if (increase) {                                                             // increase 非 0 时进入加法分支；传入 0 时走后面的 else 分支。
        if (remaining_seconds <= MAX_SECONDS - 60)                              // 先检查再加 60，保证加完不超过 5999 秒，即 99 分 59 秒。
            remaining_seconds += 60;                                            // 等价于 remaining_seconds = remaining_seconds + 60，增加一分钟。
        else { EA = 1; return; }                                                // 超出允许范围则先恢复中断，再立即结束本次函数，不修改时间。
    } else {                                                                    // increase 为 0，改为执行减一分钟的分支。
        if (remaining_seconds >= 60)                                            // 至少还剩 60 秒才允许减一分钟，防止无符号整数从 0 回绕成大数。
            remaining_seconds -= 60;                                            // 将剩余总秒数减去 60，例如 125 秒变成 65 秒。
        else { EA = 1; return; }                                                // 超出允许范围则先恢复中断，再立即结束本次函数，不修改时间。
    }                                                                           // 结束这一层语句块，按外层循环、判断或函数的结构继续执行。
    // 修改设定值，清除可能还没播完的 30 秒声光提示。
    preset_seconds = remaining_seconds;                                         // 把调节后的时间保存为以后双键复位的目标。
    if (remaining_seconds == 0) running = 0;                                    // 如果调节后恰好归零，立即将运行标记清零。
    alert30_ms = 0;                                                             // 清除 30 秒处的三声提示进度。
    beep_phase_ms = 0;                                                          // 把间歇鸣叫的周期位置归零，从周期起点开始。
    P1 &= (unsigned char)~ALERT_BIT;                                            // ~ 将 0x10 取反，再用 &= 只清除 P1.4，关闭蜂鸣器控制输出。
    display_dirty = 1;                                                          // 标记计时数字已改变，主循环稍后重新计算四个显示数字。
    EA = 1;                                                                     // 重新打开总中断；各中断还要由自己的允许位决定是否响应。
}                                                                               // 结束这一层语句块，按外层循环、判断或函数的结构继续执行。

// 函数用途：toggle_timer() —— 切换倒计时的开始与暂停。
// 工作说明：正在运行就暂停；已经暂停就开始。若剩余时间为零，先恢复保存的设定时间再尝试开始。
void toggle_timer(void)                                                         // 切换开始或暂停，无输入参数也不返回结果。
{                                                                               // 开始这一段语句块；配对的右花括号表示这段结束。
    EA = 0;                                                                     // 暂停可屏蔽中断，让下面几步操作不会被定时器中途打断。
    if (running) running = 0;                                                   // 原来在计时时就暂停；if 把非 0 看成真。
    else {                                                                      // 前面的判断都不成立时，执行这个默认分支。
        if (remaining_seconds == 0)                                             // == 是比较：判断剩余秒数是否为 0，不是把它赋值为 0。
            remaining_seconds = preset_seconds;                                 // 将保存的设定秒数复制给剩余秒数，例如设定 120 就回到 0200。
        if (remaining_seconds != 0) running = 1;                                // != 表示不等于；还有时间时才允许开始运行。
    }                                                                           // 结束这一层语句块，按外层循环、判断或函数的结构继续执行。
    display_dirty = 1;                                                          // 标记计时数字已改变，主循环稍后重新计算四个显示数字。
    EA = 1;                                                                     // 重新打开总中断；各中断还要由自己的允许位决定是否响应。
}                                                                               // 结束这一层语句块，按外层循环、判断或函数的结构继续执行。

// 函数用途：tick_countdown() —— 推进倒计时的毫秒计数。
// 工作说明：每 1 毫秒调用一次；运行时累计满 1000 毫秒减一秒，在 30/10/5 秒设置提示，归零时暂停并安排结果回报。
void tick_countdown(void)                                                       // 处理一次毫秒节拍，需要由定时中断周期调用。
{                                                                               // 开始这一段语句块；配对的右花括号表示这段结束。
    /* 只有“正在运行且还没归零”才累计时间；暂停时毫秒数保持不变。
     * ++milliseconds 是先加 1 再比较。累计到 1000，说明过了 1 秒。 */
    if (running && remaining_seconds != 0) {                                    // && 表示两项都要成立：正在计时，而且剩余时间不是 0。
        if (++milliseconds >= 1000) {                                           // 先加 1，再判断是否已累计 1000 毫秒；达到就执行减一秒。
            milliseconds = 0;                                                   // 清除这一秒累计的毫秒数，从完整的一秒重新计算。
            --remaining_seconds;                                                // 前缀 -- 让剩余总秒数减 1，例如 60 变成 59。
            display_dirty = 1;                                                  // 标记计时数字已改变，主循环稍后重新计算四个显示数字。
            /* remaining_seconds 是整数秒，所以 30、10、5 三个分界点
             * 都在显示切到相应数字的这一毫秒被发现。 */
            if (remaining_seconds == 30) alert30_ms = 600;                      // 刚进入 30 秒时开启一个持续 600 毫秒的三声提示过程。
            if (remaining_seconds == 10 || remaining_seconds == 5)              // || 表示或者；进入 10 秒或 5 秒时都要重新开始蜂鸣节奏。
                beep_phase_ms = 0;                                              // 把间歇鸣叫的周期位置归零，从周期起点开始。
            if (remaining_seconds == 0) {                                       // 剩余秒数减到 0，进入计时结束处理。
                running = 0;                                                    // 把运行标记清为 0，倒计时进入暂停状态。
                serial_status_due = 1;                                          // 先安排 00:00 状态行
                serial_result_due = 1;                                          // 到零后向电脑报告最终比分和胜者
            }                                                                   // 结束这一层语句块，按外层循环、判断或函数的结构继续执行。
        }                                                                       // 结束这一层语句块，按外层循环、判断或函数的结构继续执行。
    }                                                                           // 结束这一层语句块，按外层循环、判断或函数的结构继续执行。
}                                                                               // 结束这一层语句块，按外层循环、判断或函数的结构继续执行。

