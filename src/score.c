// ============================================================================
// 文件：src/score.c
// 用途：A、B 两队比分管理。
//
// 保存两队分数，并提供单队加减分、交换比分、同时清零的函数。
// 每队分数限制在 0～99；加到 99 后不再增加，减到 0 后不再减少。
// keys.c 的实体按键和 serial.c 的电脑命令都使用这里的计分功能或状态。
// 修改后设置 score_dirty，让主循环安排刷新计分数码管和串口状态。
// ============================================================================

#include "score.h"

unsigned char score_a = 0;                                                      // A 队分数：0～99
unsigned char score_b = 0;                                                      // B 队分数：0～99
unsigned char score_dirty = 1;                                                  // 计分数字需要刷新

// 函数用途：change_score() —— 给指定队伍加一分或减一分。
// 工作说明：team 为 0 选 A 队、为 1 选 B 队；increase 为 1 加分、为 0 减分；分数限制在 0～99 并标记显示待刷新。
void change_score(unsigned char team, unsigned char increase)                   // 修改分数：team 选择队伍，increase 选择加分或减分。
{                                                                               // 开始这一段语句块；配对的右花括号表示这段结束。
    // 直接按队伍分别修改分数，便于初学者理解，也不需要使用指针。
    if (team == 0) {                                                            // 约定 0 代表 A 队，因此这个分支修改 A 的分数。
        if (increase) {                                                         // increase 非 0 时进入加法分支；传入 0 时走后面的 else 分支。
            if (score_a < 99) ++score_a;                                        // A 队少于 99 分才加 1，达到 99 时保持不变。
        } else {                                                                // 前面的条件不成立时进入这一分支：外层选择 B 队，内层执行减分。
            if (score_a > 0) --score_a;                                         // A 队大于 0 分才减 1，避免从 0 减成 255。
        }                                                                       // 结束这一层语句块，按外层循环、判断或函数的结构继续执行。
    } else {                                                                    // 前面的条件不成立时进入这一分支：外层选择 B 队，内层执行减分。
        if (increase) {                                                         // increase 非 0 时进入加法分支；传入 0 时走后面的 else 分支。
            if (score_b < 99) ++score_b;                                        // B 队少于 99 分才加 1。
        } else {                                                                // 前面的条件不成立时进入这一分支：外层选择 B 队，内层执行减分。
            if (score_b > 0) --score_b;                                         // B 队大于 0 分才减 1。
        }                                                                       // 结束这一层语句块，按外层循环、判断或函数的结构继续执行。
    }                                                                           // 结束这一层语句块，按外层循环、判断或函数的结构继续执行。
    score_dirty = 1;                                                            // 标记比分已改变，让主循环刷新 U2，并安排向电脑报告。
}                                                                               // 结束这一层语句块，按外层循环、判断或函数的结构继续执行。

// 函数用途：swap_scores() —— 交换 A、B 两队的当前比分。
// 工作说明：用临时变量保存旧值完成互换，再通知主循环刷新计分显示。
void swap_scores(void)                                                          // 交换 A、B 两队的当前分数。
{                                                                               // 开始这一段语句块；配对的右花括号表示这段结束。
    unsigned char temp = score_a;                                               // 建立临时变量，先保存 A 的旧分数，避免下一句覆盖后找不回来。
    score_a = score_b;                                                          // 把 B 的旧分数复制给 A。
    score_b = temp;                                                             // 把之前暂存的 A 的旧分数交给 B，完成交换。
    score_dirty = 1;                                                            // 标记比分已改变，让主循环刷新 U2，并安排向电脑报告。
}                                                                               // 结束这一层语句块，按外层循环、判断或函数的结构继续执行。

// 函数用途：reset_scores() —— 把两队比分同时清零。
// 工作说明：将 A、B 分数设为 0 并标记显示待刷新，不改变倒计时的剩余时间或运行状态。
void reset_scores(void)                                                         // 同时清零两队分数。
{                                                                               // 开始这一段语句块；配对的右花括号表示这段结束。
    score_a = 0;                                                                // 将 A 队分数清零。
    score_b = 0;                                                                // 将 B 队分数清零。
    score_dirty = 1;                                                            // 标记比分已改变，让主循环刷新 U2，并安排向电脑报告。
}                                                                               // 结束这一层语句块，按外层循环、判断或函数的结构继续执行。

