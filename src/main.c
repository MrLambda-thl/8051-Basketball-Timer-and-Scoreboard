// ============================================================================
// 文件：src/main.c
// 用途：程序入口与主循环。
//
// 上电后设置 P0～P3 的初始电平，启动串口和 Timer0，并初始化 OLED。
// 随后在 while (1) 中检查任务标记，依次处理按键、数码管数据和串口收发。
// 本文件负责把各模块组织起来，具体的计时、计分和显示算法在对应模块中实现。
// 建议从这里开始阅读：看到函数调用后，再去同名模块的 .c 文件查看细节。
// ============================================================================

#include "board.h"
#include "countdown.h"
#include "score.h"
#include "keys.h"
#include "display.h"
#include "serial.h"
#include "oled.h"
#include "scheduler.h"

// 函数用途：main() —— 程序上电后的主入口。
// 工作说明：初始化端口、串口、定时器和 OLED，然后在 while (1) 中根据任务标记处理按键、显示和串口通信。
void main(void)                                                                 // 程序主入口：先执行上电初始化，再反复处理主循环任务。
{                                                                               // 开始这一段语句块；配对的右花括号表示这段结束。
    /* 上电初始化：P0 段线全灭；P1 的低 4 位和 P2 的低 4 位都为 1，
     * 所以两组数码管暂不选中任何一位；P1.4=0 关闭提示；
     * P1.5=1、P3=0xff 让按键端口保持可读取的高电平。 */
    P0 = 0x00;                                                                  // 将共用段线先全部置 0，使所有段熄灭。
    P1 = 0xef;                                                                  // 0xEF=11101111，只让 P1.4 初始为 0；数码管位选和其余 P1 引脚为 1。
    /* 0xcf 的二进制是 1100 1111：P2.4=0、P2.5=0，低四位全是 1。
     * 外接 LED 正极接 P2.5，所以 0 让它上电后先保持熄灭。 */
    P2 = 0xcf;                                                                  // 0xCF=11001111，让 P2.4 方波和 P2.5 LED 初始为 0，关闭低四位位选。
    P3 = 0xff;                                                                  // P3 各位写 1，按键输入可以被外部按键拉低；串口随后接管相应引脚功能。
    serial_init();                                                              // P3.0/P3.1 开始负责与电脑交换串口数据。
    timer0_init();                                                              // 配置并启动 Timer0：250 微秒中断，四次产生一毫秒节拍。

#if OLED_TEST_ENABLED                                                           // 条件编译：宏为 1 时才编译下面的 OLED 代码；这不是运行时的 if。
    /* 手册建议上电后等待电源稳定，再初始化 OLED。等待期间中断仍会
     * 刷新计时、计分数码管。OLED 图片仅在启动时写入一次。 */
    while (startup_ms < 200) { }                                                // 等待上电满约 200 毫秒；空循环期间定时器中断仍会执行和累加 startup_ms。
    oled_init();                                                                // 调用 OLED 初始化函数，设置寻址方式、显示方向等参数。
    oled_show_image();                                                          // 将图片和文字对应的整幅位图送到 OLED，上电只写一次。
#endif                                                                          // 结束前面的条件编译范围。

    /* while (1) 表示始终重复执行主循环；单片机上电后不能让 main 结束。
     * 主循环不使用阻塞式延时：有任务就处理，没有任务就继续循环。
     * 扫描按键和计算四位数字放在这里，避免中断程序过长。 */
    while (1) {                                                                 // 条件恒为真，所以反复执行下面的主循环，直到断电或复位。
        if (scan_due) {                                                         // 中断留下按键采样通知时，执行一次按键扫描任务。
            // 先把“待扫描”标记安全地清零，再真正读取按键。
            EA = 0;                                                             // 暂停可屏蔽中断，让下面几步操作不会被定时器中途打断。
            scan_due = 0;                                                       // 先清掉本次通知；以后中断产生的新通知仍可被下一轮处理。
            EA = 1;                                                             // 重新打开总中断；各中断还要由自己的允许位决定是否响应。
            scan_keys();                                                        // 执行按键消抖、双键优先处理和单键松开处理。
        }                                                                       // 结束这一层语句块，按外层循环、判断或函数的结构继续执行。
        if (display_dirty) {                                                    // 时间改变后才重新拆位，避免每一轮主循环重复计算。
            update_display();                                                   // 把剩余总秒数换算成计时管的四位数字。
            serial_status_due = 1;                                              // 时间变化，电脑也更新同一份时间。
        }                                                                       // 结束这一层语句块，按外层循环、判断或函数的结构继续执行。
        if (score_dirty) {                                                      // 比分改变后才刷新计分管对应的显示数组。
            update_score_display();                                             // 把 A、B 两队分数分别拆成十位和个位。
            serial_status_due = 1;                                              // 按键或串口改分后，电脑也更新比分。
            if (remaining_seconds == 0) serial_result_due = 1;                  // 比赛结束后又改了比分，也安排重新报告最终结果。
        }                                                                       // 结束这一层语句块，按外层循环、判断或函数的结构继续执行。
        serial_poll_rx();                                                       // 检查是否收到电脑的新字符，有完整命令就解析，没有就马上返回。
        serial_poll_tx();                                                       // 检查发送是否可继续，空闲时选取下一行消息，逐字节发送。
    }                                                                           // 结束这一层语句块，按外层循环、判断或函数的结构继续执行。
}                                                                               // 结束这一层语句块，按外层循环、判断或函数的结构继续执行。
